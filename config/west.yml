## config/west.yml
```yaml
manifest:
  defaults:
    revision: main
  remotes:
    - name: zmkfirmware
      url-base: https://github.com/zmkfirmware
    - name: mccheesy
      url-base: https://github.com/mccheesy
    - name: urob
      url-base: https://github.com/urob
  projects:
    - name: zmk
      remote: zmkfirmware
      import: app/west.yml
    - name: zmk-keyboard-klotz
      remote: mccheesy
    - name: zmk-leader-key
      remote: urob
      revision: main
    - name: zmk-tri-state
      remote: urob
      revision: main
  self:
    path: config
```
